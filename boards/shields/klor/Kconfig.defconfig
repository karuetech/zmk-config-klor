## boards/shields/klor/Kconfig.defconfig
```kconfig
if SHIELD_KLOR_DONGLE

    config ZMK_KEYBOARD_NAME
        default "KLOR"

    config ZMK_SPLIT_ROLE_CENTRAL
        default y

    config ZMK_SPLIT_BLE_CENTRAL_PERIPHERALS
        default 2
    config BT_MAX_CONN
        default 7
    config BT_MAX_PAIRED
        default 7

endif


if SHIELD_KLOR_LEFT || SHIELD_KLOR_RIGHT || SHIELD_KLOR_DONGLE

    config ZMK_SPLIT
        default y

endif 
```
